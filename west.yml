## west.yml
```yaml
manifest:
  remotes:
    - name: zephyrproject
      url-base: https://github.com/zephyrproject-rtos
    - name: my_app
      url-base: https://github.com/totocmc
  projects:
    - name: zephyr
      repo-path: zephyr
      remote: zephyrproject
      revision: v4.3.0
      clone-depth: 1
      import:
        path-prefix: external
        name-allowlist:
          - cmsis_6
          - picolibc
          - segger
          - hal_stm32
          - lvgl
    - name: app
      repo-path: zephyr_lvgl_app
      remote: my_app
      revision: main
```
